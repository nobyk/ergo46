## boards/shields/ergo46/Kconfig.defconfig
```kconfig
if SHIELD_ERGO46_LEFT
config ZMK_KEYBOARD_NAME
    default "ergo46"
config ZMK_SPLIT_ROLE_CENTRAL
    default y
endif

if SHIELD_ERGO46_LEFT || SHIELD_ERGO46_RIGHT
config ZMK_SPLIT
    default y
endif
```

## boards/shields/ergo46/Kconfig.shield
```kconfig
config SHIELD_ERGO46_LEFT
    def_bool $(shields_list_contains,ergo46_left)
config SHIELD_ERGO46_RIGHT
    def_bool $(shields_list_contains,ergo46_right)
```

## boards/shields/ergo46_rev3/Kconfig.defconfig
```kconfig
if SHIELD_ERGO46_REV3_LEFT
config ZMK_KEYBOARD_NAME
    default "ergo46_rev3"
config ZMK_SPLIT_ROLE_CENTRAL
    default y
endif

if SHIELD_ERGO46_REV3_LEFT || SHIELD_ERGO46_REV3_RIGHT
config ZMK_SPLIT
    default y
endif
```

## boards/shields/ergo46_rev3/Kconfig.shield
```kconfig
config SHIELD_ERGO46_REV3_LEFT
    def_bool $(shields_list_contains,ergo46_rev3_left)
config SHIELD_ERGO46_REV3_RIGHT
    def_bool $(shields_list_contains,ergo46_rev3_right)
```
